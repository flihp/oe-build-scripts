## conf/bblayers.conf
```bitbake
LCONF_VERSION = "5"
BBPATH = "${TOPDIR}"
BBFILES ?= ""
BBLAYERS = " \
    ${TOPDIR}/metas/openembedded-core/meta \
"
```

## conf/local.conf
```bitbake
BB_NUMBER_THREADS = "16"
PARALLEL_MAKE = "-j 16"

MACHINE ?= "qemux86"
DISTRO="oe-selinux"

DL_DIR = "/mnt/openembedded/downloads" 
SSTATE_DIR ?= "${TOPDIR}/sstate-cache"
TMPDIR = "${TOPDIR}/tmp"
PACKAGE_CLASSES ?= "package_ipk"
EXTRA_IMAGE_FEATURES = "debug-tweaks"
USER_CLASSES ?= "buildstats image-mklibs image-prelink"
PATCHRESOLVE = "noop"
CONF_VERSION = "1"
```
